## components/sd_logger/Kconfig
```kconfig
menu "SD Card Logger Configuration"

    config SD_LOGGER_ENABLED
        bool "Enable SD Card Logger"
        default y
        help
            Enable asynchronous MicroSD card logging.

    config SD_LOGGER_MOSI_PIN
        int "MOSI GPIO Pin"
        default 23
        depends on SD_LOGGER_ENABLED
        help
            GPIO pin for SPI MOSI (Data Output from ESP32). Default: 23.

    config SD_LOGGER_MISO_PIN
        int "MISO GPIO Pin"
        default 19
        depends on SD_LOGGER_ENABLED
        help
            GPIO pin for SPI MISO (Data Input to ESP32). Default: 19.

    config SD_LOGGER_CLK_PIN
        int "SCK/CLK GPIO Pin"
        default 18
        depends on SD_LOGGER_ENABLED
        help
            GPIO pin for SPI Clock. Default: 18.

    config SD_LOGGER_CS_PIN
        int "CS GPIO Pin"
        default 5
        depends on SD_LOGGER_ENABLED
        help
            GPIO pin for SPI Chip Select (CS). Default: 5.

    config SD_LOGGER_MAX_FILE_SIZE_KB
        int "Maximum log file size before rotation (KB)"
        default 1024
        depends on SD_LOGGER_ENABLED
        help
            Log file will be rotated (router.log -> router.log.old) when it reaches this size.

endmenu
```

## main/Kconfig.projbuild
```kconfig
menu "Example Configuration"

    config STORE_HISTORY
        bool "Store command history in flash"
        default y
        help
            Linenoise line editing library provides functions to save and load
            command history. If this option is enabled, initalizes a FAT filesystem
            and uses it to store command history.

endmenu

menu "NAT Router Uplink"

    choice UPLINK_TYPE
        prompt "Uplink interface"
        default WIFI_STA_UPLINK
        config WIFI_STA_UPLINK
            bool "WiFi STA"
        config ETH_UPLINK
            bool "Ethernet (LAN8720)"
    endchoice

    config ETH_MDC_GPIO
        int "ETH MDC GPIO"
        default 23
        depends on ETH_UPLINK

    config ETH_MDIO_GPIO
        int "ETH MDIO GPIO"
        default 18
        depends on ETH_UPLINK

    config ETH_PHY_ADDR
        int "ETH PHY address"
        default 1
        depends on ETH_UPLINK

    config ETH_PHY_POWER_GPIO
        int "ETH PHY power GPIO (-1 for none)"
        default 16
        depends on ETH_UPLINK

    config ETH_RMII_CLK_OUTPUT_GPIO
        int "RMII clock output GPIO (-1 = input from PHY)"
        default -1
        depends on ETH_UPLINK
        help
            Set to the GPIO number on which the ESP32 should generate the 50 MHz
            RMII reference clock (e.g. GPIO 17 for the Olimex ESP32-POE-ISO).
            Leave at -1 when the PHY provides the clock (e.g. WT32-ETH01).

endmenu

menu "MQTT Home Assistant"

    config MQTT_HOMEASSISTANT
        bool "Enable MQTT Home Assistant integration"
        default y
        help
            Publishes router telemetry to an MQTT broker with
            Home Assistant auto-discovery. Adds ~58 KB flash.
            RAM is only used when a broker is configured and enabled.

    config MQTT_HA_BUFFER_SIZE
        int "MQTT buffer size (bytes)"
        default 1024
        depends on MQTT_HOMEASSISTANT

    config MQTT_DEFAULT_INTERVAL
        int "Default publish interval (seconds)"
        default 30
        depends on MQTT_HOMEASSISTANT
        range 5 3600

endmenu

menu "WireGuard Auto-Enrollment (Oracle)"

    config VPN_AUTO_ENROLL_DEFAULT
        bool "Enable WireGuard Auto-Enrollment by default"
        default y
        help
            Enables automatic enrollment with the Oracle WireGuard server on boot.

    config VPN_ENROLL_URL_DEFAULT
        string "Enrollment server URL"
        default "https://168.110.106.47:8443"
        help
            Base URL of the enrollment service.

    config VPN_ENROLL_TOKEN_DEFAULT
        string "Enrollment token"
        default ""
        help
            Bearer token printed by the server. Stored in sdkconfig (not in git).
            If left empty here, it can also be configured via Web UI or CLI.

endmenu
```
